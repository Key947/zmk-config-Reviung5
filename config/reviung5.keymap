/*
 * Copyright (c) 2022 The ZMK Contributors
 *
 * SPDX-License-Identifier: MIT
 */

#include <behaviors.dtsi>
#include <dt-bindings/zmk/keys.h>
#include <dt-bindings/zmk/bt.h>
#include <dt-bindings/zmk/outputs.h>

#define BASE 0
#define BLE 1

/ {
        keymap {
            compatible = "zmk,keymap";

            base_layer {
              display-name = "BASE";
              bindings = <
                // ╭─────────────┬──────────────┬──────────────────┬─────────────┬─────────────╮
                     &bt BT_CLR   &kp Q           &kp W             &kp E         &mo 1
                // ╰─────────────┴──────────────┴──────────────────┴─────────────┴─────────────╯
              >;
              sensor-bindings = <&inc_dec_kp C_VOL_UP C_VOL_DN>;
            };

            ble_layer {
              display-name = "BLE";
              bindings = <
                // ╭─────────────┬─────────────┬─────────────┬─────────────┬─────────────╮
                     &trans       &kp A         &kp S         &kp D         &kp F
                // ╰─────────────┴─────────────┴─────────────┴─────────────┴─────────────╯
              >;
            };
        };
};
