## config/Kconfig.defconfig
```kconfig
# Copyright (c) 2022 The ZMK Contributors
# SPDX-License-Identifier: MIT

config ZMK_KEYBOARD_NAME
    default "Reviung5"

endif 

if SHIELD_REVIUNG5

if ZMK_DISPLAY

config I2C
    default y

config SPI
    default y

config SSD1306
    default y

endif #zmk_display

if LVGL

config LV_Z_VDB_SIZE
    default 32

config LV_DPI_DEF
    default 128

config LV_Z_BITS_PER_PIXEL
    default 1

choice LV_COLOR_DEPTH
    default LV_COLOR_DEPTH_1
endchoice

endif # LVGL

endif
```
